#include <Wire.h>
#include <SPI.h>
//Important! PN532 Library must be edited! Remove lower page check from ntag2xx_WritePage to allow writting to pages lower then 4 (we need write access on page 2 and 3)
#include <Adafruit_PN532.h>

#define PN532_IRQ   (2)
#define PN532_RESET (3)

Adafruit_PN532 nfc(PN532_IRQ, PN532_RESET);
void setup() {
  // put your setup code here, to run once:
 // put your setup code here, to run once:
  Serial.begin(115200);
  Serial.println(F("Hello!"));
  nfc.begin();

  uint32_t versiondata = nfc.getFirmwareVersion();
  if (! versiondata) {
    Serial.print(F("Didn't find PN53x board"));
    while (1); // halt
  }
  // Got ok data, print it out!
  Serial.print(F("Found chip PN5")); Serial.println((versiondata >> 24) & 0xFF, HEX);
  Serial.print(F("Firmware ver. ")); Serial.print((versiondata >> 16) & 0xFF, DEC);
  Serial.print('.'); Serial.println((versiondata >> 8) & 0xFF, DEC);

  // configure board to read RFID tags
  nfc.SAMConfig();
  Serial.println(F("Please Scan Blank NFC215 Tag"));
}

void loop() {
  // put your main code here, to run repeatedly:
  uint8_t success;
  uint8_t stageSuccess;
  char continueRespone = 0;
  uint8_t uid[] = { 0, 0, 0, 0, 0, 0, 0 };  // Buffer to store the returned UID
  uint8_t uidLength;                        // Length of the UID (4 or 7 bytes depending on ISO14443A card type)
  // 1.) Wait for an NTAG203 card.  When one is found 'uid' will be populated with
  // the UID, and uidLength will indicate the size of the UID (normally 7)
  success = nfc.readPassiveTargetID(PN532_MIFARE_ISO14443A, uid, &uidLength);

  // It seems we found a valid ISO14443A Tag!
  if (success)
  {
    // 2.) Display some basic information about the card
    Serial.println(F("Found card"));
    Serial.print(F("  UID Length: ")); Serial.print(uidLength, DEC); Serial.println(F(" bytes"));
    Serial.print(F("  UID Value: "));
    nfc.PrintHex(uid, uidLength);
    Serial.println("");

    if (uidLength != 7)
    {
      Serial.println(F("This doesn't seem to be an NTAG203 tag (UUID length != 7 bytes)!"));
    }
    else
    {
      Serial.println(F("\n\nSend a character to continue!"));
      while (!Serial.available());
      while (Serial.available()) {
        Serial.read();
      }
      Serial.flush();
      Serial.println(F("Valid Tag, Starting Write Process"));
      stageSuccess = writeTag();
      if (stageSuccess) {
        //Ask for confirmation
        Serial.println(F("Reading Tag for verification"));
        readTag();
        Serial.println(F("\n\nWould you like to conitnue to lock?"));
        Serial.println(F("This is irreversable, but required for use. (N/y)"));
        while (!Serial.available());
        while (Serial.available()) {
          continueRespone = Serial.read();
          if (continueRespone == 89 || continueRespone == 121) {
            stageSuccess = dynamicLockTag();
            if (stageSuccess) {
              staticLockTag();
            }
          }
          else {
            Serial.println(F("Aborting...."));
          }

        }
      }
    }

  }
  Serial.println(F("\n\nSend a character to continue!"));
  while (!Serial.available());
  while (Serial.available()) {
    Serial.read();
  }
  Serial.flush();
}
void readTag(){
    uint8_t success;
   uint8_t data[32];
      for (uint8_t i = 0; i < 135; i++) 
      {
        success = nfc.ntag2xx_ReadPage(i, data);
        // Display the current page number
        Serial.print(F("PAGE "));
        if (i < 10)
        {
          Serial.print("0");
          Serial.print(i);
        }
        else
        {
          Serial.print(i);
        }
        Serial.print(": ");

        // Display the results, depending on 'success'
        if (success) 
        {
          // Dump the page data
          nfc.PrintHexChar(data, 4);
        }
        else
        {
          Serial.println(F("Unable to read the requested page!"));
        }
      }      
}
byte writeTag() {
    uint8_t success;
  //We write pages 3 - 134, skipping page 130
  //We later will write pages 2 and 130, since these pages will lock others
  //If this step fails, we should abort to prevent killing a card
  //To-Do - add UUID check to make sure dump was edited for this uuid
  byte dataBlock[]  = {
    0x04, 0x91, 0x97, 0x8A,
    0xD2, 0x39, 0x4D, 0x80,
    0x26, 0x48, 0x00, 0x00,
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    0x80, 0x80, 0x00, 0x00
  };
  Serial.println(F("Writing Data, Please Wait. "));
  //We are gonna hardcode pages for now, NTAG 215 spec has 540 bytes in 135 pages, 4 bytes per page. Pages numbered 0 - 134
  for (byte i = 3; i < 135; i++) {
    if ( i != 130) { //skip over lock page
      Serial.print(F("Page "));
      Serial.print(i);
      Serial.print(F(": "));
      dump_byte_array(dataBlock + (i * 4), 4);
      success = nfc.ntag2xx_WritePage(i, dataBlock + (i * 4));
      Serial.println(".");
      if (!success)
      {
        Serial.println(F(" ERROR!"));
        return 0;
      }
    }
  }
  Serial.println(F(" DONE!"));
  return 1;
}
byte dynamicLockTag() {
    uint8_t success;
  //Byte 0 Byte 1 and Byte 2 are dynamic Lock Bytes
  //These are set to 0x01,0x00,and 0x0F
  //This lock pages 16-17 and block 16-31
  //Byte 3 is always 0xBD
  byte dynamicLockBlock[]    = {
    0x01, 0x00, 0x0F, 0xBD
  };
  Serial.println(F("Writing Dynamic Lock, Please Wait. "));
  dump_byte_array(dynamicLockBlock, 4);
  success = nfc.ntag2xx_WritePage(130, dynamicLockBlock);
  Serial.print(".");
  if (!success)
  {
    Serial.println(F(" ERROR!"));
    return 0;
  }
  Serial.println(F("DONE!"));
  return 1;
}
byte staticLockTag() {
   uint8_t success;
  //Byte 0 is BCC1 (copy from hex dump)
  //Byte 1 is always 48
  //Byte 2 and Byte 3 are lock bytes, set to 0x0F and 0xE0
  //This locks pages 4-10
  byte staticLockBlock[]    = {
    0x26, 0x48, 0x0F, 0xE0
  };
  Serial.println(F("Writing Static Lock, Please Wait. "));
  dump_byte_array(staticLockBlock, 4);
  success = nfc.ntag2xx_WritePage(2, staticLockBlock);
  Serial.print(".");
  if (!success)
  {
    Serial.println(F(" ERROR!"));
    return 0;
  }
  Serial.println(F("DONE!"));
  return 1;
}
void dump_byte_array(byte * buffer, byte bufferSize) {
  for (byte i = 0; i < bufferSize; i++) {
    Serial.print(buffer[i] < 0x10 ? " 0" : " ");
    Serial.print(buffer[i], HEX);
  }
  }
